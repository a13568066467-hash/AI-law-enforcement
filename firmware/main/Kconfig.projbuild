## firmware/main/Kconfig.projbuild
```kconfig
menu "AI Field Cam"

    config FSM_SELF_TEST
        bool "Run FSM logic self-test on boot (before button task)"
        default y
        help
            Runs automated state-machine checks on serial log.
            Disable for production firmware.

    config AUDIO_OUT_ENABLE
        bool "Play alerts on MAX98357A speaker (I2S)"
        default y
        help
            Drive I2S amplifier for low-battery voice-like alert.
            Disable if speaker not wired yet.

    config AUDIO_IN_ENABLE
        bool "Dual INMP441 stereo mic (noise reduction)"
        default y
        depends on AUDIO_OUT_ENABLE
        help
            Shares I2S bus with speaker. Mic1 L/GND, Mic2 R/3.3V, both SD on GPIO44.

    config CAMERA_ENABLE
        bool "OV5640 camera (XIAO Sense expansion)"
        default y
        help
            esp_camera on expansion board. Requires PSRAM.

    config BOARD_SELFTEST_ENABLE
        bool "Run board hardware self-test after init"
        default y
        help
            Pin conflict check, ADC, CHRG, beep, dual mic RMS, camera JPEG.

    menu "Battery monitor"

        config BATTERY_MONITOR_ENABLE
            bool "Enable battery percent monitor and low-battery alerts"
            default y

        config BATTERY_USE_MOCK
            bool "Use mock battery percent (no ADC wiring)"
            default n
            help
                Enable for desk test without voltage divider.
                Set MOCK percent to 9 to hear low-battery alert on boot.

        config BATTERY_MOCK_PERCENT
            int "Mock battery percent (0-100)"
            default 100
            range 0 100
            depends on BATTERY_USE_MOCK

        config BATTERY_LOW_ALERT_PERCENT
            int "Voice alert when at or below this percent (higher = earlier warning)"
            default 15
            range 1 50
            depends on BATTERY_MONITOR_ENABLE
            help
                Must be greater than RECORD_MIN. Battery draining: alert first, then block record.

        config BATTERY_RECORD_MIN_PERCENT
            int "Block new recording / AI below this percent (lower = stricter)"
            default 10
            range 1 50
            depends on BATTERY_MONITOR_ENABLE
            help
                Must be less than LOW_ALERT. e.g. alert at 15%%, block record at 10%%.

        config BATTERY_ALERT_INTERVAL_SEC
            int "Repeat low-battery voice alert interval (seconds)"
            default 120
            range 30 600
            depends on BATTERY_MONITOR_ENABLE

        config BATTERY_SAMPLE_PERIOD_MS
            int "ADC sample period (ms)"
            default 5000
            range 1000 60000
            depends on BATTERY_MONITOR_ENABLE

    endmenu

    menu "Charging (plug-in while recording)"

        config CHARGE_DETECT_ENABLE
            bool "Detect USB charging (TP4056 CHRG pin)"
            default y

        config CHARGE_USE_MOCK
            bool "Mock charging plugged (no CHRG wire)"
            default n
            depends on CHARGE_DETECT_ENABLE

        config CHARGE_MOCK_PLUGGED
            bool "Mock: treat as charging"
            default y
            depends on CHARGE_USE_MOCK

        config CHARGE_ALLOW_RECORD_WHILE_PLUGGED
            bool "Allow record / AI while charging (bypass low-battery block)"
            default y
            depends on CHARGE_DETECT_ENABLE

        config CHARGE_SKIP_LOW_PROTECT
            bool "Do not force-stop record/AI on low battery when charging"
            default y
            depends on CHARGE_DETECT_ENABLE

    endmenu

    menu "Standby power (battery life)"

        config STANDBY_MGR_ENABLE
            bool "Enable standby / AI idle power saving"
            default y

        config STANDBY_AI_LISTEN_IDLE_SEC
            int "Auto-stop AI assist after idle (seconds)"
            default 5
            range 3 120
            depends on STANDBY_MGR_ENABLE
            help
                No button/BLE activity while AI_ASSIST; matches VAD ~5s silence.

        config STANDBY_IDLE_TIMEOUT_SEC
            int "Light sleep after idle in IDLE state (seconds)"
            default 300
            range 60 3600
            depends on STANDBY_MGR_ENABLE

        config STANDBY_LIGHT_SLEEP_ENABLE
            bool "Enter ESP light sleep when idle timeout (GPIO wake)"
            default n
            depends on STANDBY_MGR_ENABLE
            help
                Enable after buttons wired; n = timer-only for desk debug.

        config STANDBY_POLL_MS
            int "Standby policy check period (ms)"
            default 1000
            range 200 5000
            depends on STANDBY_MGR_ENABLE

        config STANDBY_IMU_ENABLE
            bool "Require IMU motionless before light sleep"
            default n
            depends on STANDBY_MGR_ENABLE && STANDBY_LIGHT_SLEEP_ENABLE
            help
                When enabled, BMI270 driver TODO; use MOCK for now.

        config STANDBY_IMU_MOCK_MOTION
            bool "IMU mock: treat as motionless (allow sleep)"
            default y
            depends on STANDBY_IMU_ENABLE

    endmenu

endmenu
```

## firmware/sdkconfig.defaults
```kconfig
# Seeed XIAO ESP32S3 Sense (16MB Flash + PSRAM)
CONFIG_IDF_TARGET="esp32s3"

CONFIG_LOG_DEFAULT_LEVEL_INFO=y

# PSRAM（OV5640 JPEG 缓冲）
CONFIG_SPIRAM=y
CONFIG_SPIRAM_MODE_OCT=y
CONFIG_SPIRAM_SPEED_80M=y

# BLE（后续 ble_service.c）
CONFIG_BT_ENABLED=y
CONFIG_BT_NIMBLE_ENABLED=y

CONFIG_ESPTOOLPY_FLASHSIZE_16MB=y

# FSM 逻辑自测（串口 17/17）；量产可关
CONFIG_FSM_SELF_TEST=y

# 板级硬件自检（引脚/ADC/双麦/相机）
CONFIG_BOARD_SELFTEST_ENABLE=y

# 双麦 + 喇叭 + OV5640
CONFIG_AUDIO_OUT_ENABLE=y
CONFIG_AUDIO_IN_ENABLE=y
CONFIG_CAMERA_ENABLE=y

# 电量：先 ≤15% 提醒，再 ≤10% 禁开录/AI
CONFIG_BATTERY_MONITOR_ENABLE=y
CONFIG_BATTERY_LOW_ALERT_PERCENT=15
CONFIG_BATTERY_RECORD_MIN_PERCENT=10
CONFIG_BATTERY_ALERT_INTERVAL_SEC=120
CONFIG_BATTERY_SAMPLE_PERIOD_MS=5000
CONFIG_BATTERY_USE_MOCK=n

# 边充边录：TP4056 CHRG → GPIO5 (XIAO D4)
CONFIG_CHARGE_DETECT_ENABLE=y
CONFIG_CHARGE_ALLOW_RECORD_WHILE_PLUGGED=y
CONFIG_CHARGE_SKIP_LOW_PROTECT=y
CONFIG_CHARGE_USE_MOCK=n

# 待机续航
CONFIG_STANDBY_MGR_ENABLE=y
CONFIG_STANDBY_AI_LISTEN_IDLE_SEC=5
CONFIG_STANDBY_IDLE_TIMEOUT_SEC=300
CONFIG_STANDBY_LIGHT_SLEEP_ENABLE=n
CONFIG_STANDBY_POLL_MS=1000
```
